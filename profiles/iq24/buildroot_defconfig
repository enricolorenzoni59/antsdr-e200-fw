## profiles/iq24/buildroot_defconfig
```kconfig
# E200 userspace on the pinned ADI Buildroot/br2-external integration.
BR2_arm=y
BR2_cortex_a9=y
BR2_ARM_ENABLE_NEON=y
BR2_ARM_ENABLE_VFP=y
BR2_ARM_FPU_NEON=y
BR2_TOOLCHAIN_EXTERNAL=y
BR2_TOOLCHAIN_EXTERNAL_ARM_ARM=y
BR2_OPTIMIZE_2=y
BR2_REPRODUCIBLE=y
BR2_GLOBAL_PATCH_DIR="/project/profiles/iq24/patches"
BR2_TARGET_GENERIC_HOSTNAME="antsdr-e200"
BR2_TARGET_GENERIC_ISSUE="ANTSDR E200 experimental firmware - hardware validation pending"
BR2_ROOTFS_DEVICE_CREATION_DYNAMIC_DEVTMPFS=y
BR2_TARGET_ENABLE_ROOT_LOGIN=y
# Fixed hash for the explicitly requested development password "analog".
# Buildroot requires doubled dollars; plaintext would generate a random salt.
BR2_TARGET_GENERIC_ROOT_PASSWD="$$5$$e200iq24$$EzkBwRFR6mwhdGIsZnQz5Mldnom0km5UGS0RBMrEXGC"
BR2_TARGET_GENERIC_GETTY_PORT="ttyPS0"
BR2_ROOTFS_OVERLAY="$(E200_BOARD_DIR)/rootfs-overlay /project/profiles/iq24/rootfs-overlay"
BR2_ROOTFS_POST_BUILD_SCRIPT="$(E200_BOARD_DIR)/post-build.sh"
BR2_PACKAGE_DROPBEAR=y
BR2_PACKAGE_DROPBEAR_DISABLE_REVERSEDNS=y
BR2_PACKAGE_IPROUTE2=y
BR2_PACKAGE_ETHTOOL=y
BR2_PACKAGE_IPERF3=y
BR2_PACKAGE_PYTHON3=y
BR2_PACKAGE_LIBIIO=y
BR2_PACKAGE_LIBIIO_LOCAL_BACKEND=y
BR2_PACKAGE_LIBIIO_NETWORK_BACKEND=y
# BR2_PACKAGE_LIBIIO_USB_BACKEND is not set
# BR2_PACKAGE_LIBIIO_SERIAL_BACKEND is not set
BR2_PACKAGE_LIBIIO_IIOD=y
# BR2_PACKAGE_LIBIIO_IIOD_USBD is not set
BR2_PACKAGE_LIBIIO_TESTS=y
BR2_PACKAGE_LIBAD9361_IIO=y
BR2_TARGET_ROOTFS_CPIO=y
BR2_TARGET_ROOTFS_CPIO_GZIP=y
BR2_TARGET_ROOTFS_CPIO_UIMAGE=y
BR2_TARGET_ROOTFS_EXT2=y
BR2_TARGET_ROOTFS_EXT2_4=y
BR2_TARGET_ROOTFS_EXT2_SIZE="128M"
BR2_TARGET_ROOTFS_EXT2_LABEL="e200-rootfs"
# Deterministic metadata for the auxiliary ext4 artifact.
BR2_TARGET_ROOTFS_EXT2_MKFS_OPTIONS="-O ^64bit -U 267f58f4-5d79-5284-9a64-ab5f8e3e354d -E hash_seed=272f0e9c-2191-550c-af30-ad1c6f95b99c"
BR2_PACKAGE_HOST_UBOOT_TOOLS=y
BR2_PACKAGE_HOST_GENIMAGE=y
BR2_PACKAGE_HOST_DOSFSTOOLS=y
BR2_PACKAGE_HOST_MTOOLS=y
```
